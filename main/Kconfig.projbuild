## main/Kconfig.projbuild
```kconfig
menu "Swarmclaw Optional Hardware Tools"

    config MIMI_TOOL_RGB_ENABLED
        bool "Enable RGB control tool"
        default y
        help
            Build rgb_control tool support.

    config MIMI_TOOL_CAMERA_ENABLED
        bool "Enable camera capture tool"
        default n
        help
            Build camera_capture tool and camera core support.

    config MIMI_CAMERA_SERVER_ENABLED
        bool "Enable camera debug HTTP server"
        depends on MIMI_TOOL_CAMERA_ENABLED
        default n
        help
            Build camera HTTP server with /capture endpoint for debug.

    config MIMI_TOOL_BLE_ENABLED
        bool "Enable BLE listener tool"
        default n
        help
            Build ble_listener tool and BTHome listener support.

endmenu
```
